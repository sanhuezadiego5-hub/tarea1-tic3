## esp/main/Kconfig.projbuild
```kconfig
menu "TIC3 - bloques IMU"
    config TIC3_ACCEL_HZ
        int "ODR acelerometro (25, 50, 100, 200 o 400 Hz)"
        range 25 400
        default 400
    config TIC3_GYRO_HZ
        int "ODR giroscopio (25, 50, 100, 200 o 400 Hz)"
        range 25 400
        default 400
    config TIC3_PRINT_ARRAYS
        bool "Imprimir arreglos completos como JSON por consola"
        default n
        help
            Si esta desactivado se imprime solo un resumen de cada bloque.
            Para dos sensores a 400 Hz usar UART >= 460800 baud o USB.
            La consola es un transporte de prueba, no un cliente WiFi.
    config TIC3_INTERVAL_MS
        int "Intervalo de cierre/envio de bloques (milisegundos)"
        range 100 60000
        default 1000
        help
            1000 = 1 segundo; 5000 = 5 segundos. Los buffers se dimensionan
            segun la ODR de cada flujo. Configuraciones que excedan 128 KiB
            para pools o la RAM disponible se rechazan antes de adquirir.
    config TIC3_BLOCKS_PER_STREAM
        int "Bloques por parametro (incluye el activo)"
        range 2 4
        default 2
    choice TIC3_WIRE_FORMAT
        prompt "Formato del protocolo de datos"
        default TIC3_FORMAT_BINARY
        config TIC3_FORMAT_BINARY
            bool "Binario"
        config TIC3_FORMAT_JSON
            bool "JSON"
    endchoice
    config TIC3_WIRE_CONSOLE
        bool "Salida del protocolo por consola, en lugar de resumen/JSON de depuracion"
        default n
        help
            Activa el formato binario o JSON elegido, con prefijo de longitud.
            Para capturar binario, usar logs ESP desactivados y consola rapida.
            Esto no establece una conexion con Raspberry.
endmenu
rsource "Kconfig.wifi"
menu "TIC3 - envio a Raspberry"
    config TIC3_NETWORK_SEND
        bool "Enviar bloques al servidor IMU por sockets"
        depends on TIC3_WIFI_ENABLE
        default n
    choice TIC3_DATA_TRANSPORT
        prompt "Transporte de datos"
        default TIC3_TRANSPORT_TCP
        config TIC3_TRANSPORT_TCP
            bool "TCP con ACK de bloque guardado"
        config TIC3_TRANSPORT_UDP
            bool "UDP sin retransmision de datos"
    endchoice
    config TIC3_CONTROL_PORT
        int "Puerto TCP de control/probe para UDP"
        range 1 65535
        default 5000
endmenu
```

## esp/main/Kconfig.wifi
```kconfig
menu "TIC3 - WiFi por prioridad"
    config TIC3_WIFI_ENABLE
        bool "Activar WiFi (seleccion automatica por prioridad)"
        default n
        help
            Activado: elige automaticamente entre los perfiles habilitados,
            en orden 1, 2, 3. Desactivado: no hay conexion WiFi ni envio
            a Raspberry; no es un modo de seleccion manual.

    menu "Perfiles WiFi habilitados"
    config TIC3_WIFI_1_ENABLE
        bool "Habilitar perfil prioridad 1: AP Raspberry"
        default y
    menu "Datos del perfil 1: red y servidor"
    config TIC3_WIFI_1_SSID
        string "SSID exacto de la Raspberry"
        default "TIC3-Raccoon"
    config TIC3_WIFI_1_OPEN
        bool "Perfil 1: red abierta sin clave"
        default n
    config TIC3_WIFI_1_PASSWORD
        string "Perfil 1: clave PSK (8 a 63 caracteres; vacia si abierta)"
        default ""
    config TIC3_WIFI_1_SERVER
        string "Perfil 1: IP/nombre del servidor Raspberry"
        default "192.168.50.1"
    config TIC3_WIFI_1_PORT
        int "Perfil 1: puerto de datos"
        range 1 65535
        default 5001
    endmenu

    config TIC3_WIFI_2_ENABLE
        bool "Habilitar perfil prioridad 2: laboratorio"
        default n
    menu "Datos del perfil 2: red y servidor"
    config TIC3_WIFI_2_SSID
        string "SSID exacto del laboratorio"
        default "LAB.SISTEMAS DE COMUNICACIONES"
    config TIC3_WIFI_2_OPEN
        bool "Perfil 2: red abierta sin clave"
        default n
    config TIC3_WIFI_2_PASSWORD
        string "Perfil 2: clave PSK (8 a 63 caracteres; vacia si abierta)"
        default ""
    config TIC3_WIFI_2_SERVER
        string "Perfil 2: IP/nombre de Raspberry EN ESA RED"
        default ""
    config TIC3_WIFI_2_PORT
        int "Perfil 2: puerto de datos"
        range 1 65535
        default 5001
    endmenu

    config TIC3_WIFI_3_ENABLE
        bool "Habilitar perfil prioridad 3: WiFi actual"
        default y
    menu "Datos del perfil 3: red y servidor"
    config TIC3_WIFI_3_SSID
        string "SSID exacto del tercer perfil"
        default "WIFI_COMPARTIDO"
    config TIC3_WIFI_3_OPEN
        bool "Perfil 3: red abierta sin clave"
        default n
    config TIC3_WIFI_3_PASSWORD
        string "Perfil 3: clave PSK (8 a 63 caracteres; vacia si abierta)"
        default ""
    config TIC3_WIFI_3_SERVER
        string "Perfil 3: IP/nombre de Raspberry EN ESA RED"
        default "192.0.2.10"
    config TIC3_WIFI_3_PORT
        int "Perfil 3: puerto de datos"
        range 1 65535
        default 5001
    endmenu

    menu "Opciones avanzadas de conexion"
    config TIC3_WIFI_CONNECT_TIMEOUT_S
        int "Tiempo maximo de autenticacion y DHCP por intento"
        range 5 30
        default 15
    endmenu
    endmenu
endmenu
```

## esp/sdkconfig.defaults
```kconfig
CONFIG_IDF_TARGET="esp32s3"
CONFIG_ESP_MAIN_TASK_STACK_SIZE=16384
CONFIG_TIC3_ACCEL_HZ=400
CONFIG_TIC3_GYRO_HZ=400
CONFIG_TIC3_INTERVAL_MS=1000
CONFIG_TIC3_BLOCKS_PER_STREAM=2
```
